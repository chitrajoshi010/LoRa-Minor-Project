## forest_monitor/main/Kconfig.projbuild
```kconfig
menu "LDSE forest-monitor configuration"

    config LDSE_ROLE
        int "Device role (0=gateway, 1=relay, 2=node)"
        range 0 2
        default 0
        help
            Selects which role this firmware image runs.
            0 = gateway (ESP32-WROOM-32, mains-powered sink),
            1 = relay   (ESP32-S3, forwarder + sensors + acoustic classifier),
            2 = node    (ESP32-S3, acoustic classifier + sensors).

    menu "SX1278 radio pins"

        config LDSE_PIN_NSS
            int "NSS / SPI CS GPIO"
            default 18

        config LDSE_PIN_SCK
            int "SCK / SPI clock GPIO"
            default 13

        config LDSE_PIN_MOSI
            int "MOSI / SPI GPIO"
            default 8
            help
                S3 default is GPIO8 to avoid the mic BCK on GPIO17.
                The gateway (WROOM-32) overrides this to 23.

        config LDSE_PIN_MISO
            int "MISO / SPI GPIO"
            default 21
            help
                The gateway (WROOM-32) overrides this to 19.

        config LDSE_PIN_DIO0
            int "DIO0 / RX-TX interrupt GPIO"
            default 4

        config LDSE_PIN_RST
            int "RST / reset GPIO"
            default 14

        config LDSE_PIN_DIO1
            int "DIO1 / CAD GPIO"
            default 9
            help
                S3 default is GPIO9 to avoid the mic DIN on GPIO16.
                The gateway (WROOM-32) overrides this to 26.

    endmenu

    menu "Sleep MOSFET gate"
        depends on LDSE_ROLE = 1 || LDSE_ROLE = 2

        config LDSE_PIN_SLEEP_GATE
            int "Sleep MOSFET gate/base GPIO"
            default 10
            help
                Relay/node only. Gate (or base) of the load-switch MOSFET
                that powers the peripheral rail (MQ-135, DHT22, INMP441
                mic). Driven HIGH during SYNC/DATA and LOW during the SLEEP
                window, on the schedule the child receives from its parent
                (gateway/relay) via FTSP sync - see LdseSleepGate.h.

    endmenu

    menu "Gateway Wi-Fi"
        depends on LDSE_ROLE = 0

        config GATEWAY_WIFI_SSID
            string "Wi-Fi SSID (phone hotspot / router)"
            default ""
            help
                SSID the gateway (role 0, ESP32-WROOM-32) connects to in
                station mode. Gateway-only: relay and node roles do not
                carry Wi-Fi.

        config GATEWAY_WIFI_PASSWORD
            string "Wi-Fi password"
            default ""
            help
                Leave empty for an open network. WPA2-PSK otherwise.

    endmenu

    menu "Firebase upload (mesh schema)"
        depends on LDSE_ROLE = 0

        config FIREBASE_UPLOAD_ENABLE
            bool "Push received DATA/FIRE packets to Firebase RTDB"
            default y
            help
                When enabled, every decoded MSG_DATA / MSG_FIRE_ALERT packet
                is queued for upload to Firebase Realtime Database (mesh
                schema: /nodes/{nodeId}/latest + /nodes/{nodeId}/history),
                in addition to the existing serial CSV log. Gated on
                wifi_manager_is_connected() at upload time - disable this if
                you only want the serial CSV / serial_to_firebase.py bridge.

        config FIREBASE_API_KEY
            string "Firebase Web API key"
            depends on FIREBASE_UPLOAD_ENABLE
            default ""
            help
                From Firebase Console -> Project settings -> General ->
                Web API Key. Must match Dashboard/env.js's apiKey.

        config FIREBASE_DB_URL
            string "Firebase Realtime Database URL"
            depends on FIREBASE_UPLOAD_ENABLE
            default ""
            help
                e.g. https://your-project-default-rtdb.firebaseio.com
                (no trailing slash). Must match Dashboard/env.js's
                databaseURL.

        config FIREBASE_AUTH_EMAIL
            string "Firebase auth email"
            depends on FIREBASE_UPLOAD_ENABLE
            default ""
            help
                Email/password account (Firebase Authentication) the
                gateway signs in as to obtain a write-authorized idToken.
                Matches the account used by serial_to_firebase.py / the
                legacy ESP32 firmware's FIREBASE_EMAIL.

        config FIREBASE_AUTH_PASSWORD
            string "Firebase auth password"
            depends on FIREBASE_UPLOAD_ENABLE
            default ""

        config FIREBASE_NODE_KEY_NODE
            string "Firebase /nodes/{key} for LDSE_NODE_ID (layer-2 origin)"
            depends on FIREBASE_UPLOAD_ENABLE
            default "ForestNode-01"
            help
                This firmware currently uses fixed role IDs (single-hop
                demo: one gateway + one relay + one node), not per-device
                unique IDs. This is the Firebase node key used for packets
                whose originId == LDSE_NODE_ID (2).

        config FIREBASE_NODE_KEY_RELAY
            string "Firebase /nodes/{key} for LDSE_RELAY_ID (layer-1 origin)"
            depends on FIREBASE_UPLOAD_ENABLE
            default "ForestNode-02"
            help
                Firebase node key used for packets whose originId ==
                LDSE_RELAY_ID (1) - the relay also carries its own
                sensors/classifier and can originate MSG_DATA/MSG_FIRE_ALERT.

    endmenu

endmenu
```
